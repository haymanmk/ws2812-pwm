## Kconfig
```kconfig
menuconfig WS2812_PWM
    bool "ws2812 PWM support"
    help
        Enable this option to use the PWM peripheral to drive the WS2812 LEDs.
        This is a more efficient way to drive the LEDs compared to using the
        GPIO peripheral, as it allows for more precise timing and reduces CPU
        load. However, it may not be compatible with all LED strips.
        If you are using a different LED strip or do not need the extra
        performance, you can disable this option.
    
if WS2812_PWM

endif
```

## drivers/led_strip/ws2812_pwm/Kconfig
```kconfig
config WS2812_PWM
    bool "ws2812 PWM support"
    default y
    depends on DT_HAS_WORLDSEMI_WS2812_PWM_ENABLED
    select DMA
    help
        Enable this option to use the PWM peripheral to drive the WS2812 LEDs.
        This is a more efficient way to drive the LEDs compared to using the
        GPIO peripheral, as it allows for more precise timing and reduces CPU
        load. However, it may not be compatible with all LED strips.
        If you are using a different LED strip or do not need the extra
        performance, you can disable this option.

if WS2812_PWM

config WS2812_PWM_LOG_LEVEL_DBG
    bool "Set log level as Debug"
    help
        set the log level to the value of debug

config WS2812_PWM_LOG_LEVEL
    int "Log level"
    default 4 if WS2812_PWM_LOG_LEVEL_DBG
    default 3 
    range 0 7
    help
        Set the log level for the ws2812 PWM driver.
        0: No logging
        1: Error
        2: Warning
        3: Info
        4: Debug
        5: Trace
        6: Verbose
        7: All messages

endif # WS2812_PWM
```

## west.yml
```yaml
manifest:

  remotes:
    - name: haymanmk
      url-base: https://github.com/haymanmk
```
